## Config.in
```kconfig
menu "GameplayOS"

source "$BR2_EXTERNAL_GAMEPLAYOS_PATH/package/gameplayos-core/Config.in"

endmenu
```

## configs/gameplayos_rpi5_defconfig
```kconfig
BR2_aarch64=y
BR2_cortex_a76=y

BR2_TOOLCHAIN_BUILDROOT=y
BR2_TOOLCHAIN_BUILDROOT_MUSL=y

BR2_TARGET_GENERIC_HOSTNAME="gameplayos"
BR2_TARGET_GENERIC_ISSUE="GameplayOS"
BR2_INIT_NONE=y
BR2_ROOTFS_DEVICE_CREATION_DYNAMIC_DEVTMPFS=y
BR2_ROOTFS_OVERLAY="$(BR2_EXTERNAL_GAMEPLAYOS_PATH)/board/gameplayos/rpi5/rootfs-overlay"

BR2_GLOBAL_PATCH_DIR="board/raspberrypi/patches"
BR2_DOWNLOAD_FORCE_CHECK_HASHES=y
BR2_ROOTFS_POST_BUILD_SCRIPT="board/raspberrypi5/post-build.sh"
BR2_ROOTFS_POST_IMAGE_SCRIPT="board/raspberrypi5/post-image.sh"

BR2_LINUX_KERNEL=y
BR2_LINUX_KERNEL_CUSTOM_TARBALL=y
BR2_LINUX_KERNEL_CUSTOM_TARBALL_LOCATION="$(call github,raspberrypi,linux,21b410140c47ffab5668399f6f143c7d7b935c8b)/linux-21b410140c47ffab5668399f6f143c7d7b935c8b.tar.gz"
BR2_LINUX_KERNEL_DEFCONFIG="bcm2712"
BR2_LINUX_KERNEL_CONFIG_FRAGMENT_FILES="board/raspberrypi/linux-4k-page-size.fragment $(BR2_EXTERNAL_GAMEPLAYOS_PATH)/board/gameplayos/rpi5/linux.fragment"
BR2_LINUX_KERNEL_DTS_SUPPORT=y
BR2_LINUX_KERNEL_INTREE_DTS_NAME="broadcom/bcm2712-rpi-5-b broadcom/bcm2712d0-rpi-5-b broadcom/bcm2712-rpi-500"
BR2_LINUX_KERNEL_NEEDS_HOST_OPENSSL=y

BR2_PACKAGE_GAMEPLAYOS_CORE=y
BR2_PACKAGE_RPI_FIRMWARE=y
BR2_PACKAGE_RPI_FIRMWARE_CONFIG_FILE="$(BR2_EXTERNAL_GAMEPLAYOS_PATH)/board/gameplayos/rpi5/config.txt"
BR2_PACKAGE_RPI_FIRMWARE_CMDLINE_FILE="board/raspberrypi5/cmdline_5.txt"
BR2_PACKAGE_RPI_FIRMWARE_INSTALL_DTB_OVERLAYS=y

BR2_TARGET_ROOTFS_EXT2=y
BR2_TARGET_ROOTFS_EXT2_4=y
BR2_TARGET_ROOTFS_EXT2_SIZE="256M"
# BR2_TARGET_ROOTFS_TAR is not set

BR2_PACKAGE_HOST_DOSFSTOOLS=y
BR2_PACKAGE_HOST_GENIMAGE=y
BR2_PACKAGE_HOST_KMOD_XZ=y
BR2_PACKAGE_HOST_MTOOLS=y

# Match the custom Raspberry Pi Linux 6.12 kernel headers series.
BR2_PACKAGE_HOST_LINUX_HEADERS_CUSTOM_6_12=y
```

## package/gameplayos-core/Config.in
```kconfig
config BR2_PACKAGE_GAMEPLAYOS_CORE
	bool "gameplayos-core"
	help
	  Installs the GameplayOS PID 1 and the first native UI process.
	  No interactive shell or general-purpose command interpreter is
	  included in the target image.
```
